## config/boards/shields/plus1switch/Kconfig.defconfig
```kconfig
if SHIELD_PLUS1SWITCH

config ZMK_KEYBOARD_NAME
    default "plus1switch"

    endif
```

## config/boards/shields/plus1switch/Kconfig.shield
```kconfig
config SHIELD_PLUS1SWITCH
    def_bool $(shields_list_contains,plus1switch)

    # Enable debug logging
CONFIG_DRV2605_LOG_LEVEL_DBG=y
```
